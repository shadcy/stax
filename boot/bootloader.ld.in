#include "memory_map.h"

ENTRY(_start)
SECTIONS {
    . = BOOTLOADER_EXEC_ADDR;
    .text : { *(.text*) *(.rodata*) }
    .data : { *(.data*) }
    .bss : {
        __bss_start = .;
        *(.bss*)
        *(COMMON)
        __bss_end = .;
    }
}
